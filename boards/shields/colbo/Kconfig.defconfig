## boards/shields/colbo/Kconfig.defconfig
```kconfig
if SHIELD_COLBO_RIGHT

config ZMK_KEYBOARD_NAME
    default "colbo"

endif

if SHIELD_COLBO_LEFT || SHIELD_COLBO_RIGHT

config ZMK_SPLIT
    default y

endif
```

## boards/shields/colbo/Kconfig.shield
```kconfig
config SHIELD_COLBO_LEFT
    def_bool $(shields_list_contains,colbo_left)
config SHIELD_COLBO_RIGHT
    def_bool $(shields_list_contains,colbo_right)
```
